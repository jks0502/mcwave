#pragma once
// Read access to the packed sports font and Nailong frames (PackedAssetsData.h,
// generated by tools/pack_mcwave_assets.py). Included by exactly one
// translation unit (WeatherClock.ino) so the data exists once in flash.
#include <stdint.h>
#include <stdlib.h>
#include <string.h>
#ifdef CLOCK_NAILONG_ASSETS
#include "../EdisonAlbum/nailong/PackedAssetsData.h"
#else
#include "PackedAssetsData.h"
#endif
#if defined(ESP32)
#include <miniz.h>
#endif

struct SportsGlyphInfo {uint32_t code;uint8_t size,width;uint32_t offset;};

// One 4096-byte buffer holds the last inflated font block or a Nailong frame;
// OTA borrows it for download chunks. Pointers stay valid until the next call.
// mcwave's static DRAM is full (V5.4 left ~500 bytes), so it lives on the heap,
// allocated once on first use; nullptr means "draw nothing", never a crash.
inline uint8_t *packedAssetScratch(){static uint8_t *buffer=static_cast<uint8_t *>(malloc(kSportsBlockMax));return buffer;}
inline int &packedAssetCached(){static int block=-1;return block;}   // >=0 font block, -2-pose frame
inline void packedAssetInvalidate(){packedAssetCached()=-1;}

// Standard CRC-32 (same as zlib.crc32), checked against "123456789" in tests.
inline uint32_t packedCrc32(const uint8_t *data,size_t length){
  uint32_t crc=0xFFFFFFFFu;
  for(size_t i=0;i<length;++i){crc^=data[i];for(int b=0;b<8;++b)crc=(crc>>1)^(0xEDB88320u&(0u-(crc&1u)));}
  return ~crc;
}
inline uint8_t sportsGlyphHeight(uint16_t index){
  unsigned s=0;while(s+1<sizeof(kSportsSizes)&&index>=kSportsSizeFirst[s+1])++s;
  return kSportsSizes[s];
}
// Checkpoint, then each glyph follows the previous one (its own width and
// height) unless it has an explicit reused/reordered offset; this mirrors the
// generator's verification loop exactly.
inline uint32_t sportsOffset(uint16_t index){
  const uint16_t base=index-index%kSportsCheckpointEvery;
  uint32_t off=kSportsCheckpoints[index/kSportsCheckpointEvery];
  for(uint16_t k=base;k<=index;++k){
    if(k>base)off+=uint32_t((kSportsWidths[k-1]+7)/8)*sportsGlyphHeight(k-1);
    for(uint16_t e=0;e<kSportsExceptionCount;++e)if(kSportsExceptionIndex[e]==k)off=kSportsExceptionOffset[e];
  }
  return off;
}
inline bool findSportsGlyph(uint32_t code,int size,SportsGlyphInfo &out){
  if(code>0xFFFF)return false;
  for(unsigned s=0;s<sizeof(kSportsSizes);++s){
    if(kSportsSizes[s]!=size)continue;
    uint16_t first=kSportsSizeFirst[s],last=kSportsSizeFirst[s+1];
    while(first<last){const uint16_t mid=first+(last-first)/2;if(kSportsCodes[mid]<code)first=mid+1;else last=mid;}
    if(first==kSportsSizeFirst[s+1]||kSportsCodes[first]!=code)return false;
    out={code,uint8_t(size),kSportsWidths[first],sportsOffset(first)};
    return true;
  }
  return false;
}

#if defined(ESP32)
// Raw DEFLATE via the ESP32 ROM inflater; its ~11KB state is heap-allocated
// only for the call, never on the loop stack.
inline bool packedInflate(const uint8_t *src,size_t srcLen,uint8_t *dst,size_t dstLen){
  tinfl_decompressor *state=static_cast<tinfl_decompressor *>(malloc(sizeof(tinfl_decompressor)));
  if(!state)return false;
  tinfl_init(state);size_t in=srcLen,outLen=dstLen;
  const tinfl_status status=tinfl_decompress(state,src,&in,dst,dst,&outLen,TINFL_FLAG_USING_NON_WRAPPING_OUTPUT_BUF);
  free(state);
  return status==TINFL_STATUS_DONE&&outLen==dstLen;
}
// Counts skipped blocks so a caller (edison) can discard a page drawn with gaps.
inline uint32_t &packedAssetFailures(){static uint32_t count=0;return count;}
inline void packedAssetFailure(const char *what,unsigned index){
  ++packedAssetFailures();
  Serial.printf("[assets] %s %u failed; skipped heap=%u largest=%u\n",what,index,ESP.getFreeHeap(),ESP.getMaxAllocHeap());
}
#else
inline uint32_t &packedAssetFailures(){static uint32_t count=0;return count;}
inline void packedAssetFailure(const char *,unsigned){++packedAssetFailures();}
#endif

// Bitmap bytes for a glyph found by findSportsGlyph, or nullptr if its block
// failed to inflate/verify (the caller then draws nothing for it).
inline const uint8_t *sportsGlyphBits(const SportsGlyphInfo &g){
  uint16_t first=0,last=kSportsBlockCount;
  while(first+1<last){const uint16_t mid=(first+last)/2;if(kSportsBlockStart[mid]<=g.offset)first=mid;else last=mid;}
  const uint32_t start=kSportsBlockStart[first],length=kSportsBlockStart[first+1]-start;
  if(!packedAssetScratch()){packedAssetFailure("scratch",0);return nullptr;}
  if(packedAssetCached()!=int(first)){
    packedAssetInvalidate();
#if defined(ESP32)
    uint8_t *buffer=packedAssetScratch();
    if(!packedInflate(kSportsPackedBits+kSportsPackedOffset[first],kSportsPackedOffset[first+1]-kSportsPackedOffset[first],buffer,length)||
       packedCrc32(buffer,length)!=kSportsBlockCrc[first]){packedAssetFailure("font block",first);return nullptr;}
#else
    memcpy(packedAssetScratch(),kSportsRawBits+start,length);
    if(packedCrc32(packedAssetScratch(),length)!=kSportsBlockCrc[first])return nullptr;
#endif
    packedAssetCached()=first;
  }
  return packedAssetScratch()+(g.offset-start);
}
inline const uint8_t *nailongFrame(uint8_t pose){
  pose%=kNailongFrames;
  if(!packedAssetScratch()){packedAssetFailure("scratch",0);return nullptr;}
  if(packedAssetCached()!=-2-int(pose)){
    packedAssetInvalidate();
#if defined(ESP32)
    if(!packedInflate(kNailongPacked+kNailongPackedOffset[pose],kNailongPackedOffset[pose+1]-kNailongPackedOffset[pose],packedAssetScratch(),kNailongFrameBytes)){packedAssetFailure("nailong frame",pose);return nullptr;}
#else
    memcpy(packedAssetScratch(),kNailongRaw+uint32_t(pose)*kNailongFrameBytes,kNailongFrameBytes);
#endif
    packedAssetCached()=-2-int(pose);
  }
  return packedAssetScratch();
}
